#include "oled_spi.h"
#include <stdint.h>
#include "ti_msp_dl_config.h"
#include "delay.h"

/* ==================== 引脚操作�?==================== */
#define OLED_SPI_CS(x)   ((x) ? DL_GPIO_setPins(OLED_SPI_CS_PORT, OLED_SPI_CS_PIN)   : DL_GPIO_clearPins(OLED_SPI_CS_PORT, OLED_SPI_CS_PIN))
#define OLED_SPI_DC(x)   ((x) ? DL_GPIO_setPins(OLED_SPI_DC_PORT, OLED_SPI_DC_PIN)   : DL_GPIO_clearPins(OLED_SPI_DC_PORT, OLED_SPI_DC_PIN))
#define OLED_SPI_RES(x)  ((x) ? DL_GPIO_setPins(OLED_SPI_RES_PORT, OLED_SPI_RES_PIN) : DL_GPIO_clearPins(OLED_SPI_RES_PORT, OLED_SPI_RES_PIN))
#define OLED_SPI_SDA(x)  ((x) ? DL_GPIO_setPins(OLED_SPI_SDA_PORT, OLED_SPI_SDA_PIN) : DL_GPIO_clearPins(OLED_SPI_SDA_PORT, OLED_SPI_SDA_PIN))
#define OLED_SPI_SCL(x)  ((x) ? DL_GPIO_setPins(OLED_SPI_SCL_PORT, OLED_SPI_SCL_PIN) : DL_GPIO_clearPins(OLED_SPI_SCL_PORT, OLED_SPI_SCL_PIN))
#define OLED_SPI_BLK(x)  ((x) ? DL_GPIO_setPins(OLED_SPI_BLK_PORT, OLED_SPI_BLK_PIN) : DL_GPIO_clearPins(OLED_SPI_BLK_PORT, OLED_SPI_BLK_PIN))

/* ==================== 局部延�?==================== */
static void delay_us(uint32_t us) {
    for (uint32_t i = 0; i < us; i++) {
        delay_cycles(32);
    }
}

static void delay_ms(uint32_t ms) {
    for (uint32_t i = 0; i < ms; i++) {
        delay_us(1000);
    }
}

/* ==================== SPI 底层 ==================== */
static void OLED_SPI_Start(void) { OLED_SPI_CS(0); }
static void OLED_SPI_Stop(void)  { OLED_SPI_CS(1); }

static void OLED_SendByte(uint8_t dat) {
    for (uint8_t i = 0; i < 8; i++) {
        OLED_SPI_SCL(0);
        OLED_SPI_SDA((dat & 0x80) ? 1 : 0);
        delay_us(1);
        OLED_SPI_SCL(1);
        delay_us(1);
        dat <<= 1;
    }
    OLED_SPI_SCL(0);
}

/* 高字节先�?*/
static void OLED_SendWord(uint16_t dat) {
    OLED_SendByte((uint8_t)(dat >> 8));
    OLED_SendByte((uint8_t)(dat & 0xFF));
}

static void OLED_WriteCommand(uint8_t cmd) {
    OLED_SPI_Start();
    OLED_SPI_DC(0);
    OLED_SendByte(cmd);
    OLED_SPI_Stop();
}

static void OLED_WriteData(uint8_t dat) {
    OLED_SPI_Start();
    OLED_SPI_DC(1);
    OLED_SendByte(dat);
    OLED_SPI_Stop();
}

/* ==================== 颜色 ==================== */
uint16_t OLED_ForeColor = COLOR_WHITE;
uint16_t OLED_BackColor = COLOR_BLACK;

/* ==================== 方向与分辨率 ==================== */
uint8_t  OLED_Orientation = OLED_ORIENTATION_PORTRAIT;
uint16_t OLED_Width   = 80;
uint16_t OLED_Height  = 160;
uint16_t OLED_X_Off   = 26;
uint16_t OLED_Y_Off   = 1;

/* ==================== 窗口设置 (含行列偏移) ==================== */
static void OLED_SetWindow(uint16_t x0, uint16_t y0, uint16_t x1, uint16_t y1) {
    uint16_t xs = x0 + OLED_X_Off;
    uint16_t xe = x1 + OLED_X_Off;
    uint16_t ys = y0 + OLED_Y_Off;
    uint16_t ye = y1 + OLED_Y_Off;

    OLED_WriteCommand(0x2A); // CASET
    OLED_WriteData(xs >> 8); OLED_WriteData(xs & 0xFF);
    OLED_WriteData(xe >> 8); OLED_WriteData(xe & 0xFF);

    OLED_WriteCommand(0x2B); // RASET
    OLED_WriteData(ys >> 8); OLED_WriteData(ys & 0xFF);
    OLED_WriteData(ye >> 8); OLED_WriteData(ye & 0xFF);

    OLED_WriteCommand(0x2C); // RAMWR
}

/* ==================== 绘制 ==================== */
void OLED_DrawPixel_Ex(uint8_t x, uint8_t y, uint16_t color) {
    if (x >= OLED_Width || y >= OLED_Height) return;
    OLED_SetWindow(x, y, x, y);
    OLED_SPI_Start();
    OLED_SPI_DC(1);
    OLED_SendWord(color);
    OLED_SPI_Stop();
}

void OLED_Fill(uint16_t color) {
    OLED_SetWindow(0, 0, OLED_Width - 1, OLED_Height - 1);
    OLED_SPI_Start();
    OLED_SPI_DC(1);
    for (uint16_t y = 0; y < OLED_Height; y++) {
        for (uint16_t x = 0; x < OLED_Width; x++) {
            OLED_SendWord(color);
        }
    }
    OLED_SPI_Stop();
}

void OLED_FillRow(uint8_t Line, uint16_t color) {
    uint16_t y0 = (uint16_t)(Line - 1) * 16;
    uint16_t y1 = y0 + 15;
    if (y0 >= OLED_Height) return;
    if (y1 >= OLED_Height) y1 = OLED_Height - 1;

    OLED_SetWindow(0, y0, OLED_Width - 1, y1);
    OLED_SPI_Start();
    OLED_SPI_DC(1);
    for (uint16_t y = y0; y <= y1; y++) {
        for (uint16_t x = 0; x < OLED_Width; x++) {
            OLED_SendWord(color);
        }
    }
    OLED_SPI_Stop();
}

const uint8_t OLED_F8x16[][16] = {
    {0x00,0x00,0x00,0x00,0x00,0x00,0x00,0x00,0x00,0x00,0x00,0x00,0x00,0x00,0x00,0x00},
    {0x00,0x00,0x00,0x18,0x18,0x18,0x18,0x18,0x18,0x00,0x18,0x18,0x00,0x00,0x00,0x00},
    {0x00,0x00,0x66,0x66,0x24,0x00,0x00,0x00,0x00,0x00,0x00,0x00,0x00,0x00,0x00,0x00},
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    {0x00,0x00,0x00,0x00,0x00,0x32,0x4C,0x00,0x00,0x00,0x00,0x00,0x00,0x00,0x00,0x00},
};

/* ==================== 16x16 Hanzi Bitmaps ==================== */
const uint8_t CN_NIU[32] = {
    0x20,0x00, 0x20,0x00, 0x7F,0xF0, 0x42,0x20,
    0x42,0x20, 0x42,0x20, 0x7F,0xF0, 0x42,0x20,
    0x42,0x20, 0x42,0x20, 0x42,0x20, 0x42,0x20,
    0x42,0x20, 0x42,0x20, 0x42,0x20, 0x00,0x00,
};
const uint8_t CN_CHU[32] = {
    0x24,0x00, 0x24,0x00, 0x7F,0xE0, 0x24,0x00,
    0x24,0x00, 0x24,0x00, 0x7F,0xE0, 0x24,0x00,
    0x24,0x00, 0x24,0x00, 0x24,0x00, 0x7F,0xE0,
    0x24,0x00, 0x24,0x00, 0x24,0x00, 0x00,0x00,
};
const uint8_t CN_JI[32] = {
    0x20,0x00, 0x20,0x00, 0x7F,0xC0, 0x42,0x00,
    0x42,0x00, 0x7F,0xC0, 0x40,0x00, 0x40,0x00,
    0x7F,0xF0, 0x04,0x00, 0x04,0x00, 0x04,0x00,
    0x04,0x00, 0x04,0x00, 0x04,0x00, 0x00,0x00,
};
void OLED_ShowChinese16(uint8_t x, uint8_t y, const uint8_t bitmap[32]) {
    for (uint8_t row = 0; row < 16; row++) {
        uint8_t b1 = bitmap[row * 2];
        uint8_t b2 = bitmap[row * 2 + 1];
        for (uint8_t col = 0; col < 8; col++) {
            if (b1 & (0x80 >> col))
                OLED_DrawPixel_Ex(x + col, y + row, OLED_ForeColor);
        }
        for (uint8_t col = 0; col < 8; col++) {
            if (b2 & (0x80 >> col))
                OLED_DrawPixel_Ex(x + 8 + col, y + row, OLED_ForeColor);
        }
    }
}

void OLED_ShowChar(uint8_t Line, uint8_t Column, char Char, uint16_t color) {
    uint8_t x = (Column - 1) * 8;
    uint8_t y = (Line - 1) * 16;
    uint8_t idx = (uint8_t)(Char - ' ');
    if (idx >= 95) idx = 0;

    const uint8_t *p = OLED_F8x16[idx];

    OLED_SetWindow(x, y, x + 7, y + 15);
    OLED_SPI_Start();
    OLED_SPI_DC(1);
    for (uint8_t row = 0; row < 16; row++) {
        for (uint8_t col = 0; col < 8; col++) {
            if (p[row] & (0x80 >> col))
                OLED_SendWord(color);
            else
                OLED_SendWord(OLED_BackColor);
        }
    }
    OLED_SPI_Stop();
}

void OLED_ShowString(uint8_t Line, uint8_t Column, char *String, uint16_t color) {
    for (uint8_t i = 0; String[i] != '\0'; i++) {
        if ((Column - 1 + i) * 8 + 7 >= OLED_Width) break;
        OLED_ShowChar(Line, Column + i, String[i], color);
    }
}

/* ==================== 辅助函数 ==================== */
static uint32_t OLED_Pow(uint32_t X, uint32_t Y) {
    uint32_t Result = 1;
    while (Y--) Result *= X;
    return Result;
}

void OLED_ShowNum(uint8_t Line, uint8_t Column, uint32_t Number, uint8_t Length) {
    for (uint8_t i = 0; i < Length; i++) {
        OLED_ShowChar(Line, Column + i, Number / OLED_Pow(10, Length - i - 1) % 10 + '0', OLED_ForeColor);
    }
}

void OLED_ShowSignedNum(uint8_t Line, uint8_t Column, int32_t Number, uint8_t Length) {
    uint32_t Number1;
    if (Number >= 0) {
        OLED_ShowChar(Line, Column, '+', OLED_ForeColor);
        Number1 = Number;
    } else {
        OLED_ShowChar(Line, Column, '-', OLED_ForeColor);
        Number1 = -Number;
    }
    for (uint8_t i = 0; i < Length; i++) {
        OLED_ShowChar(Line, Column + i + 1, Number1 / OLED_Pow(10, Length - i - 1) % 10 + '0', OLED_ForeColor);
    }
}

void OLED_ShowHexNum(uint8_t Line, uint8_t Column, uint32_t Number, uint8_t Length) {
    for (uint8_t i = 0; i < Length; i++) {
        uint8_t nibble = Number / OLED_Pow(16, Length - i - 1) % 16;
        OLED_ShowChar(Line, Column + i, (nibble < 10) ? (nibble + '0') : (nibble - 10 + 'A'), OLED_ForeColor);
    }
}

void OLED_ShowBinNum(uint8_t Line, uint8_t Column, uint32_t Number, uint8_t Length) {
    for (uint8_t i = 0; i < Length; i++) {
        OLED_ShowChar(Line, Column + i, Number / OLED_Pow(2, Length - i - 1) % 2 + '0', OLED_ForeColor);
    }
}

/* ==================== 菜单行渲染 ==================== */
void OLED_MenuRow(uint8_t Line, const char *text, uint16_t textColor, uint16_t selColor, uint8_t selected) {
    uint16_t oldBack = OLED_BackColor;
    if (selected) {
        OLED_FillRow(Line, selColor);
        OLED_BackColor = selColor;   // 字符背景色匹配高亮色
    } else {
        OLED_FillRow(Line, COLOR_BLACK);
    }
    OLED_ShowString(Line, 1, (char *)text, textColor);
    OLED_BackColor = oldBack;
}

/* ==================== 偏移量校准辅�?==================== */
void OLED_CalibrateOffset(void) {
    /* 在纯色背景下画四个边角白点，方便判断偏移方向 */
    OLED_Fill(COLOR_RED);
    OLED_DrawPixel_Ex(0, 0, COLOR_WHITE);              // 左上
    OLED_DrawPixel_Ex(OLED_Width - 1, 0, COLOR_WHITE);
    OLED_DrawPixel_Ex(0, OLED_Height - 1, COLOR_WHITE);
    OLED_DrawPixel_Ex(OLED_Width - 1, OLED_Height - 1, COLOR_WHITE);
}

/* ==================== ST7735S 精简初始�?==================== */
void OLED_SetOrientation(uint8_t mode) {
    OLED_Orientation = mode;
    switch (mode) {
        case OLED_ORIENTATION_LANDSCAPE:
            OLED_Width = 160; OLED_Height = 80;
            OLED_X_Off = 1; OLED_Y_Off = 26;
            OLED_WriteCommand(0x36); OLED_WriteData(0x68);
            break;
        case OLED_ORIENTATION_PORTRAIT_REV:
            OLED_Width = 80; OLED_Height = 160;
            OLED_X_Off = 26; OLED_Y_Off = 1;
            OLED_WriteCommand(0x36); OLED_WriteData(0x08);
            break;
        case OLED_ORIENTATION_LANDSCAPE_REV:
            OLED_Width = 160; OLED_Height = 80;
            OLED_X_Off = 1; OLED_Y_Off = 26;
            OLED_WriteCommand(0x36); OLED_WriteData(0xA8);
            break;
        default: // PORTRAIT
            OLED_Width = 80; OLED_Height = 160;
            OLED_X_Off = 26; OLED_Y_Off = 1;
            OLED_WriteCommand(0x36); OLED_WriteData(0xC8);
            break;
    }
}

void OLED_Init(void) {
    delay_ms(50);
    OLED_SPI_BLK(1);
    OLED_SPI_RES(0); delay_ms(100);
    OLED_SPI_RES(1); delay_ms(50);
    OLED_WriteCommand(0x11); delay_ms(120);
    OLED_WriteCommand(0x3A); OLED_WriteData(0x05);
    OLED_WriteCommand(0x21);
    OLED_WriteCommand(0x29);
    OLED_SetOrientation(OLED_ORIENTATION_PORTRAIT);
    OLED_Fill(COLOR_BLACK);
}
